## bootdata/boot.its
```
/dts-v1/;

/ {
    description = "Minimal boot image with nano-os kernel";
    #address-cells = <1>;

    images {
        kernel-1 {
            description = "Nano-os kernel";
            data = /incbin/("kernel.bin");
            type = "kernel";
            arch = "riscv";
            os = "linux";
            compression = "none";
            load = <0x80200000>;
            entry = <0x80200000>;
            hash {
                algo = "crc32";
            };
        };

        fdt-sg2002_licheervnano_sd {
            description = "cvitek device tree - sg2002_licheervnano_sd";
            data = /incbin/("sg2002.dtb");
            type = "flat_dt";
            arch = "riscv";
            compression = "none";
            hash {
                algo = "sha256";
            };
        };
    };

    configurations {
        default = "config-sg2002_licheervnano_sd";
        config-sg2002_licheervnano_sd {
            kernel = "kernel-1";
            fdt = "fdt-sg2002_licheervnano_sd";
        };
    };

};
```
